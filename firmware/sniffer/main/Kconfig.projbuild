## firmware/sniffer/main/Kconfig.projbuild
```kconfig
menu "Probe research sniffer"
config PROBE_COUNTRY
    string "Country code (e.g. VN; local channel policy)"
    default "VN"
config PROBE_HOPPING
    bool "Hop channels (otherwise fixed channel)"
    default y
config PROBE_LAST_CHANNEL
    int "Last channel (configure for local country policy)"
    range 1 13
    default 13
config PROBE_FIXED_CHANNEL
    int "Fixed / first channel"
    range 1 11
    default 6
config PROBE_DWELL_MS
    int "Channel dwell milliseconds"
    range 100 10000
    default 3000
endmenu
```

## firmware/sniffer/sdkconfig.defaults
```kconfig
CONFIG_IDF_TARGET="esp32c3"
CONFIG_ESP_CONSOLE_UART_CUSTOM=y
CONFIG_ESP_CONSOLE_UART_NUM=0
CONFIG_ESP_CONSOLE_UART_TX_GPIO=21
CONFIG_ESP_CONSOLE_UART_RX_GPIO=20
CONFIG_ESP_CONSOLE_UART_BAUDRATE=460800
CONFIG_LOG_DEFAULT_LEVEL_NONE=y
CONFIG_FREERTOS_HZ=1000
```
